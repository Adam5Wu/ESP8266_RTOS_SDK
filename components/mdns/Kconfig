## components/mdns/Kconfig
```kconfig
menu "mDNS"

    config ENABLE_MDNS
        bool "Enable mDNS"
        default n
        help
            Enable this option and then mDNS is to be used.

    config ENABLE_MDNS_CONSOLE
        bool "Enable mDNS console"
        default n
        depends on ENABLE_MDNS
        select USING_ESP_CONSOLE
        help
            Enable this option and then mDNS console is to be used.

    config MDNS_MAX_SERVICES
        int "Max number of services"
        range 1 64
        default 10
        depends on ENABLE_MDNS
        help
            Services take up a certain amount of memory, and allowing fewer
            services to be open at the same time conserves memory. Specify
            the maximum amount of services here. The valid value is from 1
            to 64.

    config MDNS_TASK_PRIORITY
        int "mDNS task priority"
        range 1 255
        default 1
        depends on ENABLE_MDNS
        help
            Allows setting mDNS task priority. Please do not set the task priority
            higher than priorities of system tasks. Compile time warning/error
            would be emitted if the chosen task priority were too high.

    config MDNS_TASK_STACK_SIZE
        int "mDNS task stack size"
        default 4096
        depends on ENABLE_MDNS
        help
            Allows setting mDNS task stacksize.

    choice MDNS_TASK_AFFINITY
        prompt "mDNS task affinity"
        default MDNS_TASK_AFFINITY_CPU0
        depends on ENABLE_MDNS
        help
            Allows setting mDNS tasks affinity, i.e. whether the task is pinned to
            CPU0, pinned to CPU1, or allowed to run on any CPU.

        config MDNS_TASK_AFFINITY_NO_AFFINITY
            bool "No affinity"
        config MDNS_TASK_AFFINITY_CPU0
            bool "CPU0"
        config MDNS_TASK_AFFINITY_CPU1
            bool "CPU1"
            depends on !FREERTOS_UNICORE

    endchoice

    config MDNS_TASK_AFFINITY
        hex
        default FREERTOS_NO_AFFINITY if MDNS_TASK_AFFINITY_NO_AFFINITY
        default 0x0 if MDNS_TASK_AFFINITY_CPU0
        default 0x1 if MDNS_TASK_AFFINITY_CPU1
        depends on ENABLE_MDNS

    config MDNS_SERVICE_ADD_TIMEOUT_MS
        int "mDNS adding service timeout (ms)"
        range 10 30000
        default 2000
        depends on ENABLE_MDNS
        help
            Configures timeout for adding a new mDNS service. Adding a service
            fails if could not be completed within this time.

    config MDNS_STRICT_MODE
        bool "mDNS strict mode"
        default "n"
        depends on ENABLE_MDNS
        help
            Configures strict mode. Set this to 1 for the mDNS library to strictly follow the RFC6762:
            Currently the only strict feature: Do not repeat original questions in response packets
            (defined in RFC6762 sec. 6).
            Default configuration is 0, i.e. non-strict mode, since some implementations,
            such as lwIP mdns resolver (used by standard POSIX API like getaddrinfo, gethostbyname)
            could not correctly resolve advertised names.

    config MDNS_TIMER_PERIOD_MS
        int "mDNS timer period (ms)"
        range 10 10000
        default 100
        depends on ENABLE_MDNS
        help
            Configures period of mDNS timer, which periodically transmits packets
            and schedules mDNS searches.

    config MDNS_MULTIPLE_INSTANCE
        bool "Multiple instances under the same service type"
        default y
        depends on ENABLE_MDNS
        help
            Enables adding multiple service instances under the same service type.

endmenu
```
