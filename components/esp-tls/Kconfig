## components/pthread/Kconfig
```kconfig
menuconfig PTHREAD_ENABLE
    bool "Enable POSIX Threads (pthread) support"
    default n
    help
        Enable POSIX Threads (pthread) API, including pthread_create/join,
        pthread_mutex_*, pthread_cond_*, pthread_once, and pthread TLS keys.

        Core SDK components (lwip, newlib, etc.) do not require pthreads.
        Keeping this disabled saves 8 bytes per FreeRTOS task TCB and catches
        accidental gthread/pthread_* dependencies at link time. Enable this
        if your application uses std::mutex, std::thread, std::condition_variable,
        or pthread_* APIs (COMPILER_CXX_EXCEPTIONS selects this automatically).

if PTHREAD_ENABLE

        config PTHREAD_TASK_PRIO_DEFAULT
            int "Default task priority"
            range 0 255
            default 5
            help
                Priority used to create new tasks with default pthread parameters.

        config PTHREAD_TASK_STACK_SIZE_DEFAULT
            int "Default task stack size"
            default 3072
            help
                Stack size used to create new tasks with default pthread parameters.

        config PTHREAD_STACK_MIN
            int "Minimum allowed pthread stack size"
            default 768
            help
                Minimum allowed pthread stack size set in attributes passed to pthread_create

        config PTHREAD_TASK_NAME_DEFAULT
            string "Default name of pthreads"
            default "pthread"
            help
                The default name of pthreads.

endif
```
