## components/esp8266/Kconfig
```kconfig
menu "ESP8266-specific"

config ESP8266_NMI_WDT
    bool "Enable non-mask watch dog"
    default y
    help
        Important: this non-mask watch dog is registered to non-mask timer0,
                   so it can not work together with PWM.

        Enable this non-mask watch dog can help users to debug blocking code
        when CPU is at critical state(disable interrupt).


choice ESP8266_XTAL_FREQ_SEL
    prompt "Main XTAL frequency"
    default ESP8266_XTAL_FREQ_26
    help
        ESP8266 currently supports the following XTAL frequencies:

        - 26 MHz
        - 40 MHz
    config ESP8266_XTAL_FREQ_40
        bool "40 MHz"
    config ESP8266_XTAL_FREQ_26
        bool "26 MHz"
endchoice

config ESP8266_XTAL_FREQ
    int
    default 40 if ESP8266_XTAL_FREQ_40
    default 26 if ESP8266_XTAL_FREQ_26

choice ESP8266_DEFAULT_CPU_FREQ_MHZ
    prompt "CPU frequency"
    default ESP8266_DEFAULT_CPU_FREQ_160
    help
        CPU frequency to be set on application startup.

    config ESP8266_DEFAULT_CPU_FREQ_80
        bool "80 MHz"
    config ESP8266_DEFAULT_CPU_FREQ_160
        bool "160 MHz"
endchoice

config ESP8266_DEFAULT_CPU_FREQ_MHZ
    int
    default 80 if ESP8266_DEFAULT_CPU_FREQ_80
    default 160 if ESP8266_DEFAULT_CPU_FREQ_160

choice ESP_FILENAME_MACRO
    prompt "File name macro text"
    default ESP_FILENAME_MACRO_NO_PATH
    help
        This option allows configuring the macro __ESP_FILE__ text.
        Three options are possible:

        no PATH: strip the path of macro __FILE__, for example: __FILE__="a/b/c/d.h", then __ESP_FILE__="d.h"

        raw: same as macro __FILE__

        null: text is string "null"

config ESP_FILENAME_MACRO_NO_PATH
    bool "no PATH"
config ESP_FILENAME_MACRO_RAW
    bool "raw"
config ESP_FILENAME_MACRO_NULL
    bool "null"
endchoice

config USING_NEW_ETS_VPRINTF
    bool "Using new ets_vprintf instead of rom code"
    default y
    help
        Enable this option, SDK will use new "ets_vprintf" function instead of old code "ets_vprintf" which is depend on ROM
        code "ets_io_vprintf".

        Note: Bootloader can't use this function.

config LINK_ETS_PRINTF_TO_IRAM
    bool "Link ets_printf to IRAM"
    default n
    help
        Enable this option, SDK will link the old/new "ets_printf" and "ets_vprintf" to IRAM instead of flash.
        So although flash can't be access for SoC when reading to writing, the "ets_printf" and "ets_vprintf" also can be used by user.

        Using new "ets_vprintf" should cost more 1.6KB IRAM.

        Note: Bootloader can't use this function.

config ETS_PRINTF_EXIT_WHEN_FLASH_RW
    bool "ets_printf exits when flash R/W"
    default y
    depends on !LINK_ETS_PRINTF_TO_IRAM
    help
        By default option, we link the ets_printf function and its calling functions
        in SPI Flash. So when the SPI Flash is working in read/write mode, and we
        call ets_printf in high level interrupt like NMI, this behavior will cause a
        crash, and the EXCCAUSE=0.

        Enable this option, we link the ets_printf in IRAM, and its calling functions
        in SPI Flash. In the entry of ets_printf, we check if the SPI Flash is working
        in read/write mode, and exit if it is. So that ets_printf will not call functions
        in SPI Flash.

config SOC_FULL_ICACHE
    bool "Enable full cache mode"
    default n
    help
        Enable this option, full 32 KB iram instead of 16 KB iram will be used as icache, so the heap use can use
        may reduce a lot.

config SOC_IRAM_SIZE
    hex
    default 0x8000 if SOC_FULL_ICACHE
    default 0xC000 if !SOC_FULL_ICACHE

config DISABLE_ROM_UART_PRINT
    bool "Disable ROM UART print"
    default n
    help
        "Disable main part of ROM UART print when rom bootloader process."

choice ESP_PANIC
    prompt "Panic handler behaviour"
    default ESP_PANIC_PRINT_REBOOT
    help
        If an unhandled exception, the panic handler is invoked.
        Configure the panic handlers action here.

config ESP_PANIC_PRINT_HALT
    bool "Print registers and halt"
    help
        Outputs the relevant registers over the serial port and halt the
        processor. Needs a manual reset to restart.

config ESP_PANIC_PRINT_REBOOT
    bool "Print registers and reboot"
    help
        Outputs the relevant registers over the serial port and immediately
        reset the processor.

config ESP_PANIC_SILENT_REBOOT
    bool "Silent reboot"
    help
        Just resets the processor without outputting anything

config ESP_PANIC_GDBSTUB
    bool "Invoke GDBStub"
    select ESP_GDBSTUB_ENABLED
    help
        Invoke gdbstub on the serial port, allowing for gdb to attach to it to do a postmortem
        of the crash.

        The UART's baudrate should be 115200 or others which can be recognized by xtensa GDB.
endchoice

config RESET_REASON
    bool "Enable reset reason"
    default y
    help
        Enable this option, the reset reason function can be used, or compiler will show function linking error.

config WIFI_PPT_TASKSTACK_SIZE
    int "ppT task stack size" if !ESP8266_OSS_PHY_ONLY
    range 2048 8192
    default 2048 if !ESP8266_WIFI_ENABLE_WPA3_SAE
    default 5120 if ESP8266_WIFI_ENABLE_WPA3_SAE
    help
        Configure the Wi-Fi worker task stack size (bytes).

        - Open-source Wi-Fi: sets the n8_worker_task stack size, silently
          floored at 3072 bytes at runtime (even if configured lower).
        - Vendor Wi-Fi: sets the ppT task stack size (2048..8192).

        This task also invokes the promiscuous RX callback; increase the
        stack size if user callbacks are complex.

config ESP8266_CORE_GLOBAL_DATA_LINK_IRAM
    bool "Link ESP8266 core internal global data to IRAM"
    default y
    depends on !LWIP_HIGH_THROUGHPUT
    depends on !SOC_FULL_ICACHE
    help
        Link ESP8266 core internal global data (.bss .data COMMON) from DRAM to IRAM.

config INIT_OS_BEFORE_START
    bool "Init OS before starting it"
    default n
    depends on DISABLE_FREERTOS
    help
        Some OSes should initialize their global data structure before starting them. rt-thread is like this one.

        FreeRTOS need not do this.

config ESP8266_OTA_FROM_OLD
    bool "ESP8266 update from old SDK by OTA"
    default n
    depends on IDF_TARGET_ESP8266
    select ESP8266_BOOT_COPY_APP if ESPTOOLPY_FLASHSIZE_1MB
    help
        The function is not released.

        Enable this option, script will generate the complete firmware for both old RTOS SDK(before V3.0)
        and NonOS SDK to update to v3 by OTA.

        The old RTOS SDK(before V3.0) or NonOS SDK can download the firmware to its partition and run it as it self's application.

config LOAD_OLD_RF_PARAMETER
    bool "Load old RF Parameters"
    default n
    depends on ESP8266_OTA_FROM_OLD
    select ESP_PHY_INIT_DATA_IN_PARTITION
    help
        The function is not released.

        Enable this option, after updating from old SDK to new SDK, bootloader will copy RF
        parameters from old SDK partition to new SDK partition.

        Then application can read the RF parameters from new partition directly.

config ESP8266_BOOT_COPY_APP
    bool "Boot copy app"
    default n
    help
        The function is not released.

        Enable this option, when it is that "OTA1" application is to run after update by OTA,
        bootloader will copy "OTA1" application to "OTA0" partition and run "OTA0".

    choice ESP8266_TIME_SYSCALL
        prompt "Timers used for gettimeofday function"
        default ESP8266_TIME_SYSCALL_USE_FRC1
        help
            This setting defines which hardware timers are used to
            implement 'gettimeofday' and 'time' functions in C library.

            - If high-resolution timer is used, gettimeofday will
              provide time at microsecond resolution.
              Time will not be preserved when going into deep sleep mode.
            - If no timers are used, gettimeofday and time functions
              return -1 and set errno to ENOSYS.

        config ESP8266_TIME_SYSCALL_USE_FRC1
            bool "High-resolution timer"
        config ESP8266_TIME_SYSCALL_USE_NONE
            bool "None"
    endchoice

    menu "Open-Source / Vendor Blob Selection"

        config ESP8266_VENDOR_BLOBS
            bool "Allow prebuilt vendor blobs"
            default n
            help
                By default, ESP8266_RTOS_SDK builds 100% from open-source
                implementations with zero prebuilt vendor binary archives linked.

                Enable this option to unlock legacy prebuilt vendor archives in
                components/esp8266/lib/ (HAL, Core/RTC, Wi-Fi, ESP-NOW, and
                SmartConfig).

        choice ESP8266_HAL_IMPL
            prompt "HAL implementation"
            default ESP8266_OSS_HAL
            help
                Select the Xtensa LX106 Call0 Core HAL implementation:

                - Open-source: clean-room components/esp8266/source/xtensa_hal.S.
                - Vendor blob: prebuilt components/esp8266/lib/libhal.a
                  (requires Allow prebuilt vendor blobs).

                Fully ABI-compatible and independently mixable with either
                open-source or vendor Core/Wi-Fi layers.

            config ESP8266_OSS_HAL
                bool "Open-source"
            config ESP8266_VENDOR_HAL
                bool "Vendor blob"
                depends on ESP8266_VENDOR_BLOBS
        endchoice

        choice ESP8266_PHY_WIFI_IMPL
            prompt "Wi-Fi & PHY implementation"
            default ESP8266_OSS_PHY_WIFI
            help
                Select the SoC PHY (BBPLL, RTC PMU/sleep, ROM-I2C/PBUS, SAR ADC)
                and Wi-Fi RF/LMAC/802.11 implementation:

                - Open-source (PHY + Wi-Fi): clean-room components/esp8266/{phy,lmac,net80211}/.
                - Vendor blobs (PHY + Wi-Fi): prebuilt monolithic libphy.a + libpp.a +
                  libnet80211.a (requires Allow prebuilt vendor blobs).
                - Open-source PHY only (no Wi-Fi): clean-room SoC PHY (RTC cali, BBPLL,
                  light/deep sleep, SAR ADC/VDD33) with zero Wi-Fi RF/MAC/802.11 code
                  or Wi-Fi blobs (100% zero-blob when Allow prebuilt vendor blobs is
                  disabled; still mixable with Vendor HAL).

            config ESP8266_OSS_PHY_WIFI
                bool "Open-source (PHY + Wi-Fi)"
            config ESP8266_VENDOR_PHY_WIFI
                bool "Vendor blobs (PHY + Wi-Fi)"
                depends on ESP8266_VENDOR_BLOBS
            config ESP8266_OSS_PHY_ONLY
                bool "Open-source PHY only (no Wi-Fi)"
        endchoice

        config ESP8266_OSS_PHY
            bool
            default y if !ESP8266_VENDOR_PHY_WIFI

        choice ESP8266_CORE_IMPL
            prompt "Core & RTC implementation"
            default ESP8266_OSS_CORE
            help
                Select the SoC Core (ets_timer, misc, misc_nvs, sys_ctrl) and
                RTC/Clock implementation:

                - Open-source: clean-room components/esp8266/source/esp_*.c
                  (compatible with Open-source (PHY + Wi-Fi),
                  Vendor blobs (PHY + Wi-Fi), or Open-source PHY only).
                - Vendor blobs: prebuilt libcore.a + libclk.a + librtc.a
                  (requires Allow prebuilt vendor blobs and
                  Vendor blobs (PHY + Wi-Fi)).

            config ESP8266_OSS_CORE
                bool "Open-source"
            config ESP8266_VENDOR_CORE
                bool "Vendor blobs"
                depends on ESP8266_VENDOR_BLOBS && ESP8266_VENDOR_PHY_WIFI
        endchoice

        config ESP8266_VENDOR_ESPNOW
            bool "Vendor ESP-NOW"
            depends on ESP8266_VENDOR_BLOBS && ESP8266_VENDOR_PHY_WIFI
            default n
            help
                Link the prebuilt vendor ESP-NOW archive
                (components/esp8266/lib/libespnow.a / libespnow_dbg.a).

                Requires Vendor blobs (PHY + Wi-Fi) (libnet80211.a / libpp.a).
                When disabled, links a minimal open-source esp_now_deinit() stub.

        config ESP8266_VENDOR_SMARTCONFIG
            bool "Vendor SmartConfig"
            depends on ESP8266_VENDOR_BLOBS && ESP8266_VENDOR_PHY_WIFI
            default n
            help
                Compile SmartConfig wrappers (source/smartconfig*.c) and link
                the prebuilt vendor archive (components/esp8266/lib/libsmartconfig.a).

                Requires Vendor blobs (PHY + Wi-Fi) (libnet80211.a).

    endmenu  # Open-Source / Vendor Blob Selection
endmenu

menu "Power Management"
    config PM_ENABLE
        bool "Support for power management"
        default n
        help
            If enabled, application is compiled with support for power management.
            This option has run-time overhead (increased interrupt latency,
            longer time to enter idle state), and it also reduces accuracy of
            RTOS ticks and timers used for timekeeping.
            Enable this option if application uses power management APIs.
endmenu

menu Wi-Fi
    visible if !ESP8266_OSS_PHY_ONLY

config SCAN_AP_MAX
    int "Max scan AP number"
    range 1 100
    default 99
    help
        Maximum number of AP records returned by a Wi-Fi scan.

        - Open-source Wi-Fi: scan result storage is capped at 64 APs
          (net80211_scan.c), even if configured higher.
        - Vendor Wi-Fi: honors values up to 100.

        "esp_wifi_scan_get_ap_num" returns at most this count; users can also
        query "esp_wifi_scan_get_ap_num_max" to determine the configured cap.

config WIFI_TX_RATE_SEQUENCE_FROM_HIGH
    bool "Set WiFi TX rate from 54M to 1M"
    default y
    help
        Configure the initial TX rate policy.

        - Open-source Wi-Fi (lmac_trc.c): y initializes windowed AARF at
          MCS7/54M (clamped on weak < -80 dBm links), and n initializes at
          MCS4/24M.
        - Vendor Wi-Fi: when y, sends packets starting from 54M down to 1M
          until transmission succeeds.

config ESP8266_WIFI_QOS_ENABLED
    bool "WiFi QoS"
    default n
    help
        Select this option to enable QoS feature

config ESP8266_WIFI_AMPDU_RX_ENABLED
    bool "WiFi AMPDU RX"
    select ESP8266_WIFI_QOS_ENABLED
    default n
    help
        Select this option to enable AMPDU RX feature

config ESP8266_WIFI_RX_BA_WIN_SIZE
    int "WiFi AMPDU RX BA window size"
    depends on ESP8266_WIFI_AMPDU_RX_ENABLED
    range 0 16
    default 6
    help
        Set the size of WiFi Block Ack RX window. Generally a bigger value means higher throughput and better
        compatibility but more memory.

config ESP8266_WIFI_AMSDU_ENABLED
    bool "WiFi AMSDU RX"
    depends on ESP8266_VENDOR_PHY_WIFI
    default n
    help
        Select this option to enable AMSDU feature

config ESP8266_WIFI_RX_BUFFER_NUM
    int "Max number of WiFi RX buffers"
    range 14 28
    default 16
    help
        Set the number of Wi-Fi RX buffers.

        - Open-source Wi-Fi (lmac_internal.h, lmac_pm_compat.c): each buffer
          is 524 B in a contiguous DMA arena and the count is capped at 24
          (LMAC_MAX_RX_BUFS).
        - Vendor Wi-Fi: honors up to 28 buffers (each ~524 B; 26 is
          recommended for shieldbox iperf).

        Most applications should keep the default unless tuning peak RX
        throughput.

config ESP8266_WIFI_LEFT_CONTINUOUS_RX_BUFFER_NUM
    int "The min number of WiFi continuous RX buffer"
    range 0 16
    default 16
    help
        Set the continuous RX buffer threshold.

        - Open-source Wi-Fi (net80211_data.c): sets the hybrid zero-copy vs.
          heap-copy RX threshold (free_contiguous > threshold &&
          free_8bit > 6 KB). With defaults 16/16, free_contiguous <= 15 so
          OSS always copies to heap and recycles DMA immediately; lowering
          below RX_BUFFER_NUM - 1 enables zero-copy RX into lwIP.
        - Vendor Wi-Fi: reserves minimum contiguous DMA headroom to prevent
          vendor RX hangs.

config ESP8266_WIFI_RX_PKT_NUM
    int "Max number of WiFi RX packets"
    depends on ESP8266_VENDOR_PHY_WIFI
    range 4 16
    default 7
    help
        Set the max number of signle WiFi packet.

config ESP8266_WIFI_TX_PKT_NUM
    int "Max number of WiFi TX packets"
    range 4 16
    default 6
    help
        Set the number of Wi-Fi TX slots/packets.

        - Open-source Wi-Fi (lmac_tx.c): TX slots are scatter-gather DMA
          descriptors (~216 B/slot default, ~188 B/slot with
          ESP8266_OSS_WIFI_MIN_NMI=y, not 1.6 KB/buffer) and the pool is
          floored at 10 slots when ESP8266_OSS_WIFI_MIN_NMI=n (values 4..9
          apply only when ESP8266_OSS_WIFI_MIN_NMI=y).
        - Vendor Wi-Fi: each buffer consumes ~1.6 KB of RAM; increase for
          bursty UDP traffic.

config ESP8266_WIFI_NVS_ENABLED
    bool "WiFi NVS flash"
    default y
    help
        Select this option to enable WiFi NVS flash.

        Under Open-source Wi-Fi, disabling NVS (n) causes
        ESP8266_OSS_WIFI_RTC_FAST_CONNECT to default to y.

config ESP8266_WIFI_CONNECT_OPEN_ROUTER_WHEN_PWD_IS_SET
    bool "Connect open router when wifi password is set"
    default y
    help
        When this option is enabled, ESP8266 will connect to open router even if wifi password is set, otherwise 
        ESP8266 will not connect to open router when wifi password is set.

config ESP8266_WIFI_ENABLE_WPA3_SAE
    bool "Enable WPA3-Personal"
    default y
    help
        Select this option to allow the device to establish a WPA3-Personal connection with eligible AP's.
        PMF (Protected Management Frames) is a prerequisite feature for a WPA3 connection, it needs to be
        explicitly configured before attempting connection. Please refer to the Wi-Fi Driver API Guide for details.

config ESP8266_OSS_WIFI_MIN_NMI
    bool "Minimal IRAM NMI handler"
    depends on ESP8266_OSS_PHY_WIFI
    default n
    help
        Disable the IRAM Level-3 NMI fast TX retry/launch path in
        lmac_nmi.c (wDev_ProcessFiq).

        By default (n), retryable TX completions and queued TX launches
        execute directly in IRAM NMI so TX continues uninterrupted across
        SPI flash erase/read cache-off windows (+708 B IRAM, still ~50%
        less IRAM than vendor blobs).

        Enable (y) to defer all TX handling to the flash-resident Wi-Fi
        worker task and reclaim those 708 B of static IRAM.

config ESP8266_OSS_WIFI_TASK_PRIO
    int "OSS Wi-Fi worker task priority"
    depends on ESP8266_OSS_PHY_WIFI
    range 1 14
    default 13
    help
        FreeRTOS priority for the unified open-source Wi-Fi worker task (1..14).
        Defaults to 13 (below the configMAX_PRIORITIES-1 = 14 ceiling) so the
        worker runs above tcpip/application tasks while preserving one headroom
        slot for urgent system tasks.

config ESP8266_OSS_WIFI_RTC_FAST_CONNECT
    bool "Cache STA PMK and channel in RTC_SYS across warm resets"
    depends on ESP8266_OSS_PHY_WIFI
    default y if !ESP8266_WIFI_NVS_ENABLED
    default n
    help
        Cache the derived 32-byte WPA2 PMK, BSSID, and channel in 64 bytes of
        RTC_SYS memory so warm resets / OTA reboots skip PBKDF2-SHA1 and probe
        the cached channel first. Cleared automatically on power-on reset.

config ESP8266_WIFI_DEBUG_LOG_ENABLE
    bool "Enable WiFi debug log"
    depends on ESP8266_VENDOR_PHY_WIFI
    default n
    help
        Select this option to enable WiFi debug log

choice ESP8266_WIFI_DEBUG_LOG_LEVEL
    depends on ESP8266_WIFI_DEBUG_LOG_ENABLE
    prompt "The DEBUG level is enabled"
    default ESP8266_WIFI_DEBUG_LOG_ERROR
    help
        The WiFi log is divided into the following levels: ERROR,WARNING,INFO,DEBUG,VERBOSE.
        The ERROR level is enabled by default, and the WARNING,INFO,DEBUG,VERBOSE levels can be enabled here.

    config ESP8266_WIFI_DEBUG_LOG_ERROR
        bool "Error"
    config ESP8266_WIFI_DEBUG_LOG_WARNING
        bool "Warning"
    config ESP8266_WIFI_DEBUG_LOG_INFO
        bool "Info"
    config ESP8266_WIFI_DEBUG_LOG_DEBUG
        bool "Debug"
    config ESP8266_WIFI_DEBUG_LOG_VERBOSE
        bool "Verbose"
endchoice

config ESP8266_WIFI_DEBUG_LOG_SUBMODULE
    depends on ESP8266_WIFI_DEBUG_LOG_ENABLE
    bool "WiFi debug log submodule"
    default n
    help
        Enable this option to set the WiFi debug log submodule.
        Currently the log submodule contains the following parts: INIT,IOCTL,CONN,SCAN.
        The INIT submodule indicates the initialization process.The IOCTL submodule indicates the API calling
        process.
        The CONN submodule indicates the connecting process.The SCAN submodule indicates the scaning process.

config ESP8266_WIFI_DEBUG_LOG_SUBMODULE_CORE
    depends on ESP8266_WIFI_DEBUG_LOG_SUBMODULE
    bool "core"
    default n
    help
        When this option is enabled, log for core module will be enabled..

config ESP8266_WIFI_DEBUG_LOG_SUBMODULE_SCAN
    depends on ESP8266_WIFI_DEBUG_LOG_SUBMODULE
    bool "scan"
    default n
    help
        When this option is enabled, log for scan module will be enabled.

config ESP8266_WIFI_DEBUG_LOG_SUBMODULE_PM
    depends on ESP8266_WIFI_DEBUG_LOG_SUBMODULE
    bool "power management"
    default n
    help
        When this option is enabled, log for power management module will be enabled.

config ESP8266_WIFI_DEBUG_LOG_SUBMODULE_NVS
    depends on ESP8266_WIFI_DEBUG_LOG_SUBMODULE
    bool "NVS"
    default n
    help
        When this option is enabled, log for NVS module will be enabled.

config ESP8266_WIFI_DEBUG_LOG_SUBMODULE_TRC
    depends on ESP8266_WIFI_DEBUG_LOG_SUBMODULE
    bool "TRC"
    default n
    help
        When this option is enabled, log for TRC module will be enabled.

config ESP8266_WIFI_DEBUG_LOG_SUBMODULE_EBUF
    depends on ESP8266_WIFI_DEBUG_LOG_SUBMODULE
    bool "EBUF"
    default n
    help
        When this option is enabled, log for EBUF module will be enabled.

config ESP8266_WIFI_DEBUG_LOG_SUBMODULE_NET80211
    depends on ESP8266_WIFI_DEBUG_LOG_SUBMODULE
    bool "NET80211"
    default n
    help
        When this option is enabled, log for net80211 module will be enabled.

config ESP8266_WIFI_DEBUG_LOG_SUBMODULE_TIMER
    depends on ESP8266_WIFI_DEBUG_LOG_SUBMODULE
    bool "TIMER"
    default n
    help
        When this option is enabled, log for timer module will be enabled.

config ESP8266_WIFI_DEBUG_LOG_SUBMODULE_ESPNOW
    depends on ESP8266_WIFI_DEBUG_LOG_SUBMODULE && ESP8266_VENDOR_ESPNOW
    bool "ESPNOW"
    default n
    help
        When this option is enabled, log for espnow module will be enabled.

config ESP8266_WIFI_DEBUG_LOG_SUBMODULE_MAC
    depends on ESP8266_WIFI_DEBUG_LOG_SUBMODULE
    bool "MAC layer"
    default n
    help
        When this option is enabled, log for mac layer module will be enabled.

config ESP8266_WIFI_DEBUG_LOG_SUBMODULE_WPA
    depends on ESP8266_WIFI_DEBUG_LOG_SUBMODULE
    bool "wpa"
    default n
    help
        When this option is enabled, log for wpa module will be enabled.

config ESP8266_WIFI_DEBUG_LOG_SUBMODULE_WPS
    depends on ESP8266_WIFI_DEBUG_LOG_SUBMODULE
    bool "wps"
    default n
    help
        When this option is enabled, log for wps module will be enabled.

config ESP8266_WIFI_DEBUG_LOG_SUBMODULE_AMPDU
    depends on ESP8266_WIFI_DEBUG_LOG_SUBMODULE
    bool "ampdu"
    default n
    help
        When this option is enabled, log for ampdu module will be enabled.

config ESP8266_WIFI_DEBUG_LOG_SUBMODULE_AMSDU
    depends on ESP8266_WIFI_DEBUG_LOG_SUBMODULE
    bool "amsdu"
    default n
    help
        When this option is enabled, log for amsdu module will be enabled.

config ESP8266_WIFI_DEBUG_LOG_SUBMODULE_FRAG
    depends on ESP8266_WIFI_DEBUG_LOG_SUBMODULE
    bool "fragment"
    default n
    help
        When this option is enabled, log for frag module will be enabled.

config ESP8266_WIFI_DEBUG_LOG_SUBMODULE_WPA2
    depends on ESP8266_WIFI_DEBUG_LOG_SUBMODULE
    bool "wpa2_enterprise"
    default n
    help
        When this option is enabled, log for wpa2_enterprise module will be enabled.

endmenu

menu PHY

config ESP_PHY_CALIBRATION_AND_DATA_STORAGE
    bool "Store phy calibration data in NVS" if !ESP8266_OSS_PHY_ONLY
    default y
    help
        If this option is enabled, NVS will be initialized and calibration data will be loaded from there.
        If calibration data is not found, full calibration will be performed and stored in NVS. Normally,
        only partial calibration will be performed. If this option is disabled, full calibration will be performed.

        Full calibration needs 170 - 180ms.
        Partial calibration needs 35 - 40ms.
        No calibration needs 3.260 - 3.264ms.

        If it's easy that your board calibrate bad data, choose 'n'.
        Two cases for example, you should choose 'n':
        1.If your board is easy to be booted up with antenna disconnected.
        2.Because of your board design, each time when you do calibration, the result are too unstable.
        If unsure, choose 'y'.

config ESP_PHY_INIT_DATA_IN_PARTITION
    bool "Use a partition to store PHY init data" if !ESP8266_OSS_PHY_ONLY
    default n
    help
        If enabled, PHY init data will be loaded from a partition.
        When using a custom partition table, make sure that PHY data
        partition is included (type: 'data', subtype: 'phy').
        With default partition tables, this is done automatically.
        If PHY init data is stored in a partition, it has to be flashed there,
        otherwise runtime error will occur.

        If this option is not enabled, PHY init data will be embedded
        into the application binary.

        If unsure, choose 'n'.

config ESP_PHY_INIT_DATA_VDD33_CONST
    int "vdd33_const value"
    range 0 255
    default 33
    help
        vdd33_const provides ADC mode settings, i.e. selecting system voltage or external voltage measurements. 
        When measuring system voltage, it must be set to 255. 
        To read the external voltage on TOUT(ADC) pin, vdd33_const need less than 255
        When the ADC reference voltage is set to the actual VDD33 power supply voltage, the value range of vdd33_const is [18,36], the unit is 0.1V.
        When the ADC reference voltage is set to the default value of 3.3V as the supply voltage, the range of vdd33_const is [0, 18] or (36, 255).

config ESP8266_PHY_MAX_WIFI_TX_POWER
    int "Max WiFi TX power (dBm)" if !ESP8266_OSS_PHY_ONLY
    range 0 21
    default 20
    help
        Set maximum transmit power for WiFi radio. Actual transmit power for high
        data rates may be lower than this setting.

endmenu  # PHY

menu HSPI
config ESP8266_HSPI_HIGH_THROUGHPUT
    bool "Do some optimization to improve throughput"
    default n
    help
        If enable this configuration, some spi api will be placed into iram.
        And it will reduce iram memory.
endmenu  # Driver
```
